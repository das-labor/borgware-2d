## config.in
```kconfig
mainmenu_name "Borg Configuration"

### General Setup Menu ########################################################
mainmenu_option next_comment
comment "General Setup"
	#bool 'Prompt for experimental code' CONFIG_EXPERIMENTAL

	choice 'Target MCU'           \
	  "ATmega1280     atmega1280  \
	   ATmega1284     atmega1284  \
	   ATmega1284P    atmega1284p \
	   ATmega16       atmega16    \
	   ATmega164      atmega164   \
	   ATmega164P     atmega164p  \
	   ATmega168      atmega168   \
	   ATmega168P     atmega168p  \
	   ATmega2560     atmega2560  \
	   ATmega32       atmega32    \
	   ATmega324      atmega324   \
	   ATmega324P     atmega324p  \
	   ATmega328      atmega328   \
	   ATmega328P     atmega328p  \
	   ATmega32U4     atmega32u4  \
	   ATmega48       atmega48    \
	   ATmega48P      atmega48p   \
	   ATmega644      atmega644   \
	   ATmega644P     atmega644p  \
	   ATmega8        atmega8     \
	   ATmega8515     atmega8515  \
	   ATmega88       atmega88    \
	   ATmega88P      atmega88p"  \
	   'ATmega32' MCU

	int "MCU frequency" FREQ 16000000
endmenu
###############################################################################


### Borg Hardware Menu ########################################################
source src/borg_hw/config.in
###############################################################################


### Features Menu #############################################################
mainmenu_option next_comment
comment "Features"
	bool     "prng random number generator" RANDOM_SUPPORT y
	dep_bool "CAN Time Extension"   LAP_TIME_EXTENSION $CAN_SUPPORT
endmenu
###############################################################################


### Scrolltext Menu ###########################################################
source src/scrolltext/config.in
###############################################################################


### RFM12 Menu ################################################################
source src/rfm12/config.in
###############################################################################


### Joystick Menu #############################################################
source src/joystick/config.in
###############################################################################


### CAN Menu ##################################################################
source src/can/config.in
###############################################################################


### UART Menu #################################################################
source src/uart/config.in
###############################################################################


### Borg Menu #################################################################
dep_bool "Menu Support" MENU_SUPPORT $JOYSTICK_SUPPORT
###############################################################################


### Game Menu #################################################################
source src/games/config.in
###############################################################################


### Animations Menu ###########################################################
source src/animations/config.in
###############################################################################


### Small Animations Menu #####################################################
source src/smallani/config.in
###############################################################################


### User Menu #################################################################
source src/user/config.in
###############################################################################
```

## src/joystick/config.in
```kconfig
#mainmenu_option next_comment
dep_bool_menu "Joystick Support" JOYSTICK_SUPPORT y
# comment "Joystick Support"

# bool "Joystick Support" JOYSTICK_SUPPORT n


if [ "$PLATFORM" == "avr" ]; then

    if [ "x$JOYSTICK_CHOICE" == "x" ] ; then
       define_string JOYSTICK_CHOICE "JOY_PARALLEL"
    fi

    if [ "$JOYSTICK_SUPPORT" = "y" ]; then
       choice 'Joystick Type' \
          "Atari-9-Pin   JOY_PARALLEL \
           NES-Game-Pad  JOY_NES_PAD \
           RFM12         JOY_RFM12 \
           LED-Brett     JOY_LEDBRETT \
           LoL-Shield    JOY_LOLSHIELD \
           Webbrowser    JOY_BROWSER \
           None          JOY_NULL" \
           'Atari-9-Pin' JOYSTICK_CHOICE
    fi
elif [ "$PLATFORM" == "wasm" ]; then

   choice 'Joystick Type' \
      "Webbrowser    JOY_BROWSER \
       None          JOY_NULL" \
       'Webbrowser' JOYSTICK_CHOICE
fi

###################### parallel joystick menu #################################
   if [ "$JOYSTICK_CHOICE" == "JOY_PARALLEL" ]; then
      mainmenu_option next_comment
      comment "Joystick Settings"

      define_bool PARALLEL_JOYSTICK_SUPPORT y
      choice 'Pin up' \
         "PINA  PINA \
          PINB  PINB \
          PINC  PINC \
          PIND  PIND" \
         'PINB' JOYSTICK_PIN_UP

      choice 'Bit up' \
         "Bit0 0 \
          Bit1 1 \
          Bit2 2 \
          Bit3 3 \
          Bit4 4 \
          Bit5 5 \
          Bit6 6 \
          Bit7 7" \
         'Bit0' JOYSTICK_BIT_UP

      choice 'Pin down' \
         "PINA  PINA \
          PINB  PINB \
          PINC  PINC \
          PIND  PIND" \
         'PINB' JOYSTICK_PIN_DOWN

      choice 'Bit down' \
         "Bit0 0 \
          Bit1 1 \
          Bit2 2 \
          Bit3 3 \
          Bit4 4 \
          Bit5 5 \
          Bit6 6 \
          Bit7 7" \
         'Bit1' JOYSTICK_BIT_DOWN

      choice 'Pin left' \
         "PINA  PINA \
          PINB  PINB \
          PINC  PINC \
          PIND  PIND" \
         'PINB' JOYSTICK_PIN_LEFT

      choice 'Bit left' \
         "Bit0 0 \
          Bit1 1 \
          Bit2 2 \
          Bit3 3 \
          Bit4 4 \
          Bit5 5 \
          Bit6 6 \
          Bit7 7" \
         'Bit2' JOYSTICK_BIT_LEFT

      choice 'Pin right' \
         "PINA  PINA \
          PINB  PINB \
          PINC  PINC \
          PIND  PIND" \
         'PINB' JOYSTICK_PIN_RIGHT

      choice 'Bit right' \
         "Bit0 0 \
          Bit1 1 \
          Bit2 2 \
          Bit3 3 \
          Bit4 4 \
          Bit5 5 \
          Bit6 6 \
          Bit7 7" \
         'Bit3' JOYSTICK_BIT_RIGHT

      choice 'Pin fire' \
         "PINA  PINA \
          PINB  PINB \
          PINC  PINC \
          PIND  PIND" \
         'PIND' JOYSTICK_PIN_FIRE

      choice 'Bit fire' \
         "Bit0 0 \
          Bit1 1 \
          Bit2 2 \
          Bit3 3 \
          Bit4 4 \
          Bit5 5 \
          Bit6 6 \
          Bit7 7" \
         'Bit3' JOYSTICK_BIT_FIRE

      endmenu
   fi
###############################################################################

###################### NES-Pad menu ###########################################
   if [ "$JOYSTICK_CHOICE" == "JOY_NES_PAD" ]; then
      mainmenu_option next_comment
      comment "Joystick Settings"

      define_bool NES_PAD_SUPPORT y

      choice 'Port clk' \
         "PORTA  PORTA \
          PORTB  PORTB \
          PORTC  PORTC \
          PORTD  PORTD" \
         'PORTB' NES_PAD_PORT_CLK

      choice 'Port ds' \
         "PORTA  PORTA \
          PORTB  PORTB \
          PORTC  PORTC \
          PORTD  PORTD" \
         'PORTB' NES_PAD_PORT_PL

      choice 'Pin pl' \
         "PORTA  PORTA \
          PORTB  PORTB \
          PORTC  PORTC \
          PORTD  PORTD" \
         'PORTB' NES_PAD_PORT_DS

      choice 'Bit clk' \
         "Bit0 0 \
          Bit1 1 \
          Bit2 2 \
          Bit3 3 \
          Bit4 4 \
          Bit5 5 \
          Bit6 6 \
          Bit7 7" \
         'Bit0' NES_PAD_BIT_CLK

      choice 'Bit pl' \
         "Bit0 0 \
          Bit1 1 \
          Bit2 2 \
          Bit3 3 \
          Bit4 4 \
          Bit5 5 \
          Bit6 6 \
          Bit7 7" \
         'Bit1' NES_PAD_BIT_PL

      choice 'Bit ds' \
         "Bit0 0 \
          Bit1 1 \
          Bit2 2 \
          Bit3 3 \
          Bit4 4 \
          Bit5 5 \
          Bit6 6 \
          Bit7 7" \
         'Bit2' NES_PAD_BIT_DS

      endmenu
   fi
###############################################################################

###################### RFM12 joystick menu ####################################
   if [ "$JOYSTICK_CHOICE" == "JOY_RFM12" ]; then
      define_bool RFM12_JOYSTICK_SUPPORT y
   fi
###############################################################################

###################### 74HC165 joystick menu #################################
   if [ "$JOYSTICK_CHOICE" == "JOY_LEDBRETT" ]; then
      mainmenu_option next_comment
      comment "Joystick Settings"

      define_bool HC165_JOYSTICK_SUPPORT y

      choice 'Port load' \
         "PORTA  PORTA \
          PORTB  PORTB \
          PORTC  PORTC \
          PORTD  PORTD" \
         'PORTD' HC165_JOYSTICK_PORT_LOAD

      choice 'Bit load' \
         "Bit0 0 \
          Bit1 1 \
          Bit2 2 \
          Bit3 3 \
          Bit4 4 \
          Bit5 5 \
          Bit6 6 \
          Bit7 7" \
         'Bit2' HC165_JOYSTICK_BIT_LOAD

      endmenu
   fi
###############################################################################

###################### LoL Shield joystick menu ###############################
   if [ "$JOYSTICK_CHOICE" == "JOY_NULL" ]; then
      define_bool NULL_JOYSTICK_SUPPORT y
   fi
###############################################################################

###################### null joystick menu #####################################
   if [ "$JOYSTICK_CHOICE" == "JOY_LOLSHIELD" ]; then
      define_bool LOLSHIELD_JOYSTICK_SUPPORT y
   fi
###############################################################################

   if [ "$JOYSTICK_CHOICE" == "JOY_BROWSER" ]; then
      define_bool BROWSER_JOYSTICK_SUPPORT y
   fi

endmenu
```

## src/platform/wasm/config.in
```kconfig
choice 'Target Borg'          \
   "Lounge-Borg original"     \
    'Lounge-Borg' TARGET_BORG
```
